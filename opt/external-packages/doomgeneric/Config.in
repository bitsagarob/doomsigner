## opt/external-packages/doomgeneric/Config.in
```kconfig
config BR2_PACKAGE_DOOMGENERIC
	bool "doomgeneric"
	help
	  DOOM, targeting the SeedSigner panel and buttons.

	  Boots as one of the games offered before the wallet starts. The
	  unlock sequence hands off to SeedSigner exactly as the Python
	  games do.

	  https://github.com/ozkl/doomgeneric
```

## opt/external-packages/libsecp256k1/Config.in
```kconfig
config BR2_PACKAGE_LIBSECP256K1
	bool "libsecp256k1"
	help
	  Optimized C library for ECDSA signatures and secret/public key
	  operations on curve secp256k1.

	  Built here because embit needs it and no longer ships prebuilt
	  binaries: embit's package explicitly excludes *.so, so without a
	  system library it falls back to a pure-Python implementation that is
	  far too slow to sign on a Pi Zero, and does so silently.

	  https://github.com/bitcoin-core/secp256k1
```

## opt/external-packages/python-pydnssec-prover/Config.in
```kconfig
config BR2_PACKAGE_PYTHON_PYDNSSEC_PROVER
	bool "python-pydnssec-prover"
	help
	  Offline DNSSEC validation of RFC 9102 proofs, in pure Python.

	  This is what lets the signing app check a BIP-353 payment name
	  on the device instead of trusting the coordinator that sent
	  the PSBT.

	  https://github.com/bitsagarob/pydnssec-prover
```
